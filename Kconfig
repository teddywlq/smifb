## Kconfig
```kconfig
# SPDX-License-Identifier: GPL-2.0-only
config DRM_SMI
	tristate "SiliconMotion SM750/SM768/SM770 DRM driver"
        depends on DRM && PCI && MMU && SND
        select DRM_TTM
        select DRM_KMS_HELPER
        select SND_PCM
        select DRM_VRAM_HELPER
        help
		Say yes for SiliconMotion SM750/SM768/SM770 DRM driver.
config DRM_SMI_LT8618
	bool "LT8618 HDMI transmitter support"
	depends on DRM_SMI
	help
	  Enable the external LT8618 HDMI transmitter on boards using
	  the SM768 channel 0 TTL output.
         
```
